## Kconfig.projbuild
```kconfig
menu "AsyncUDP Configuration"

choice ASYNC_UDP_RUNNING_CORE
    bool "Core on which Async UDP is running"
    default ASYNC_UDP_RUN_CORE0
    help
        Select on which core Arduino's UDP run

    config ASYNC_UDP_RUN_CORE0
        bool "CORE 0"
    config ASYNC_UDP_RUN_CORE1
        bool "CORE 1"
        depends on !FREERTOS_UNICORE
    config ASYNC_UDP_RUN_NO_AFFINITY
        bool "BOTH"
        depends on !FREERTOS_UNICORE

endchoice

config ASYNC_UDP_RUNNING_CORE
    int
    default 0 if ASYNC_UDP_RUN_CORE0
    default 1 if ASYNC_UDP_RUN_CORE1
    default -1 if ASYNC_UDP_RUN_NO_AFFINITY

config ASYNC_UDP_TASK_PRIORITY
    int "Priority of the UDP task"
    default 3
    help
        Select at what priority you want the UDP task to run.

endmenu
```
